## conf/bblayers.conf
```bitbake
# POKY_BBLAYERS_CONF_VERSION is increased each time build/conf/bblayers.conf
# changes incompatibly
POKY_BBLAYERS_CONF_VERSION = "2"

BBPATH = "${TOPDIR}"
BBFILES ?= ""

BBLAYERS ?= " \
  /home/mavila/tec/yocto-project/poky-dunfell-23.0.2/meta \
  /home/mavila/tec/yocto-project/poky-dunfell-23.0.2/meta-poky \
  /home/mavila/tec/yocto-project/poky-dunfell-23.0.2/meta-yocto-bsp \
  /home/mavila/tec/yocto-project/poky-dunfell-23.0.2/meta-raspberrypi \
  "
```
